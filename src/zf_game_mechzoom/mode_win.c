// module implementation for z-fighter game "mechzoom"
// by xrrawva 2021

#include <stdlib.h>
#include <zf_gfx.h>
#include <zf_lcd.h>
#include <zf_sleep.h>
#include "bgm.h"
#include "mode_game.h"
#include "mode_win.h"
#include "sound.h"
#include "tilemap.h"
#include "ui.h"
#define TRUE 1
#define FALSE 0

void modeWin()
{
    // close door
    for(unsigned char i=0;i<5;i++)
    {
        drawScreenGate(4-i);
        lcd(screen);
        sleep(50);
    }

    sleep(950);

    // open door
    for(unsigned char i=1;i<6;i++)
    {
        color=0;
        cls();
        drawScreenGate(i);
        lcd(screen);
        sleep(100);
    }

    showTextPage(//"1234567812345678\n"
                   "Congratulations,\n"
                   "after this\n"
                   "dangerous\n"
                   "journey you have\n"
                   "reached your\n"
                   "destination.");

    char str[]=//"1234567812345678\n"
                 "On the way you\n"
                 "have salvaged ?   \n"
                 "abandoned mechs,\n"
                 "destroyed ?   \n"
                 "space junk and\n"
                 "killed ?   \n"
                 "innocent aliens.";
    utoa(scoreMech,str+29,10);
    if     (scoreMech>99)str[32]=' ';
    else if(scoreMech> 9)str[31]=' ';
    else                 str[30]=' ';
    utoa(scoreJunk,str+61,10);
    if     (scoreJunk>99)str[64]=' ';
    else if(scoreJunk> 9)str[63]=' ';
    else                 str[62]=' ';
    utoa(scoreAlien,str+88,10);
    if     (scoreAlien>99)str[91]=' ';
    else if(scoreAlien> 9)str[90]=' ';
    else                  str[89]=' ';
    showTextPage((const char*)str);

    signed int score=scoreMech*16 + scoreJunk - scoreAlien*32;
    if(score<0)score=0;
    signed int scoreMax=scoreMaxMech*16 + scoreMaxJunk;
    if(scoreMax<0)scoreMax=0;
    char str2[]=//"1234567812345678\n"
                  "Max. Score:\n"
                  "?      \n"
                  " \n"
                  "Your Score:\n"
                  "?      ";
    utoa(scoreMax,str2+12,10);
    if     (scoreMax>9999)str2[17]=' ';
    else if(scoreMax> 999)str2[16]=' ';
    else if(scoreMax>  99)str2[15]=' ';
    else if(scoreMax>   9)str2[14]=' ';
    else                  str2[13]=' ';
    utoa(score,str2+34,10);
    if     (score>9999)str2[39]=' ';
    else if(score> 999)str2[38]=' ';
    else if(score>  99)str2[37]=' ';
    else if(score>   9)str2[36]=' ';
    else               str2[35]=' ';
    showTextPage(str2);
    fadeToBlack();

    const unsigned char spEndscreenBase[]={128,64,0x24,0x40,0x22,0x24,0x8A,0x48,0xA4,0x8A,0x48,0x08,0x4A,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0x0C,0xC4};
    const unsigned char spEndscreenAlien[]={26,8,112,127,241,174,7,216,114,131,224,40,135,240,2,0,124,0,0,246,0,0,31,160,0,3,223,0};
    const unsigned char spEndscreenMech[]={28,26,34,0,0,1,48,0,0,1,128,0,8,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0,0};
    const unsigned char spEndscreenJunk[]={52,16,0,0,0,0,0,0,112,0,0,0,0,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11,248};
    color=1;
    sprite(spEndscreenBase,0,0);
    if(scoreMech<scoreMaxMech>>1)spriteTransparent(spEndscreenMech,96,28);
    color=0;
    if(scoreAlien<scoreMaxAlien>>1)spriteTransparent(spEndscreenAlien,32,14);
    if(scoreJunk<scoreMaxJunk>>1)spriteTransparent(spEndscreenJunk,31,16);
    lcd(screen);
    while(!keyOk(TRUE)); // TODO: replace with bgmPlayUntilKeyOk();
    soundOk();

    fadeToWhite();
    color=1;
    cls();
    lcd(screen);
    sleep(1000);
}

void drawScreenGate(unsigned char open)
{
    const unsigned char tilesetDoor[]={0,0,0,0,0,0,0,0,                 //  0 transparent
                                       0,0,0,0,0,0,0,0,                 //  1 blank
                                       0,0,0,0,255,255,255,0,           //  2 edge down
                                       14,29,59,119,111,95,63,127,      //  3 edge down 45
                                       0,0,0,0,0,0,2,6,                 //  4 edge down 45 extended
                                       255,254,252,248,240,224,192,128, //  5 edge up 45
                                       85,170,85,170,85,170,85,170,     //  6 shaded
                                       85,170,84,168,80,160,64,128,     //  7 shaded 45 top left
                                       0,0,0,0,0,0,255,255,             //  8 edge up
                                       0,0,0,0,0,0,1,3,                 //  9 shaded 45 bottom right extended
                                       7,14,29,58,117,234,213,170};     // 10 shaded 45 bottom right
    unsigned char tilemapDoorTop[16*8]={ 7, 9,10, 6, 6, 6, 6, 6, 1, 6, 6, 6, 6, 6, 1, 6,
                                         9,10, 6, 6, 6, 6, 6, 6, 1, 6, 6, 6, 6, 6, 1, 6,
                                        10, 6, 6, 6, 6, 6, 6, 6, 1, 6, 6, 6, 6, 6, 1, 6,
                                         6, 6, 6, 6, 6, 6, 6, 7, 4, 2, 2, 2, 2, 2, 2, 2,
                                         2, 2, 2, 2, 2, 2, 2, 2, 3, 0, 0, 0, 0, 0, 0, 0,
                                         0, 0, 0, 0, 0, 0, 0, 0, 0, 0, 0, 0, 0, 0, 0, 0,
                                         0, 0, 0, 0, 0, 0, 0, 0, 0, 0, 0, 0, 0, 0, 0, 0,
                                         0, 0, 0, 0, 0, 0, 0, 0, 0, 0, 0, 0, 0, 0, 0, 0};
    unsigned char tilemapDoorBottom[16*8]={ 0, 0, 0, 0, 0, 0, 0, 0, 0, 0, 0, 0, 0, 0, 0, 0,
                                            0, 0, 0, 0, 0, 0, 0, 0, 0, 0, 0, 0, 0, 0, 0, 0,
                                            0, 0, 0, 0, 0, 0, 0, 0, 0, 0, 0, 0, 0, 0, 0, 0,
                                            0, 0, 0, 0, 0, 0, 0, 0, 5, 9, 8, 8, 8, 8, 8, 8,
                                            8, 8, 1, 8, 8, 8, 8, 8, 1,10, 6, 6, 6, 6, 6, 6,
                                            6, 6, 1, 6, 6, 6, 6, 6, 1, 6, 6, 6, 6, 6, 6, 7,
                                            6, 6, 1, 6, 6, 6, 6, 6, 1, 6, 6, 6, 6, 6, 7, 9,
                                            6, 6, 1, 6, 6, 6, 6, 6, 1, 6, 6, 6, 6, 7, 9,10};
    color=1;
    tileset=tilesetDoor;
    drawTilemapOverlay(tilemapDoorTop   ,-open);
    drawTilemapOverlay(tilemapDoorBottom, open);
    if(open==0)block(tilesetDoor+8,8,3);
}
