// module implementation for z-fighter game "mechzoom"
// by xrrawva 2021

#include <zf_gfx.h>
#include <zf_lcd.h>
#include <zf_text.h>
#include "mode_title.h"
#include "sound.h"
#include "ui.h"
#define TRUE 1
#define FALSE 0

const unsigned char spriteTitle[]={128,64,0x03,0xFF,0xFF,0xF1,0xF0,0x00,0x00,0x00,0xFF,0xC0,0x20,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0x00,0x00};

unsigned char modeTitle()
{
    color=1;
    cls();
    sprite(spriteTitle,0,0);

    unsigned char cursor=0;
    while(TRUE)
    {
        print((unsigned char*)" New Game ",3,4);
        print((unsigned char*)" Options  ",3,5);
        print((unsigned char*)" Exit",3,6);
        block(bpCursor,3,4+cursor);
        color=0;point(22,45);point(22,46);point(21,47);
        color=1;if(cursor==1){point(22,45);point(22,46);}if(cursor==2)point(21,47);
        lcd(screen);

        if(keyOk(TRUE))
        {
            soundOk();
            if(cursor==0)
            {
                return TRUE;
            }
            else if(cursor==1)
            {
                modeOption();
            }
            else if(cursor==2)
            {
                return FALSE;
            }
        }
        else if(keyBack(TRUE))
        {
            soundBack();
            cursor=2;
        }
        else if(keyUp(TRUE))
        {
            if(cursor>0)
            {
                soundSelect();
                cursor--;
            }
        }
        else if(keyDown(TRUE))
        {
            if(cursor<2)
            {
                soundSelect();
                cursor++;
            }
        }
    }
}

void modeOption()
{
    unsigned char cursor=0;
    while(TRUE)
    {
        color=1;
        print((unsigned char*)" Light:On ",3,4);
        if(!backlight)print((unsigned char*)"ff",11,4);
        print((unsigned char*)" Sound:On ",3,5);
        if(mute)print((unsigned char*)"ff",11,5);
        print((unsigned char*)" Back",3,6);
        block(bpCursor,3,4+cursor);
        color=0;point(22,45);point(22,46);point(21,47);
        color=1;if(cursor==1){point(22,45);point(22,46);}if(cursor==2)point(21,47);
        lcd(screen);

        if(keyOk(TRUE))
        {
            soundOk();
            if(cursor==0)
            {
                if(backlight)backlight=FALSE;
                else         backlight=TRUE;
            }
            else if(cursor==1)
            {
                if(mute)mute=FALSE;
                else    mute=TRUE;
            }
            else if(cursor==2)
            {
                return;
            }
        }
        else if(keyBack(TRUE))
        {
            soundBack();
            cursor=2;
        }
        else if(keyUp(TRUE))
        {
            if(cursor>0)
            {
                soundSelect();
                cursor--;
            }
        }
        else if(keyDown(TRUE))
        {
            if(cursor<2)
            {
                soundSelect();
                cursor++;
            }
        }
    }
}
